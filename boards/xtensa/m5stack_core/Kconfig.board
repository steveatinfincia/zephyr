## boards/xtensa/m5stack_core/Kconfig.board
```kconfig
# M5Stack Core configuration

# Copyright (c) 2022 Stephen Oliver
# SPDX-License-Identifier: Apache-2.0

config BOARD_M5STACK_CORE
	bool "m5stack_core"
	depends on SOC_ESP32
```

## boards/xtensa/m5stack_core/Kconfig.defconfig
```kconfig
# M5Stack Core configuration

# Copyright (c) 2022 Stephen Oliver
# SPDX-License-Identifier: Apache-2.0

config BOARD
	default "m5stack_core"
	depends on BOARD_M5STACK_CORE

config ENTROPY_ESP32_RNG
	default y if ENTROPY_GENERATOR

config SPI
	default y if DISPLAY

if BT

config HEAP_MEM_POOL_SIZE
	default 16384

config ENTROPY_GENERATOR
	default y

choice BT_HCI_BUS_TYPE
	default BT_ESP32
endchoice

endif # BT
```
